## config/west.yml
```yaml
manifest:
  remotes:
  - name: zmkfirmware
    url-base: https://github.com/zmkfirmware
    # Additional modules containing boards/shields/custom code can be listed here as well
    # See https://docs.zephyrproject.org/3.2.0/develop/west/manifest.html#projects
  projects:
  - name: zmk
    remote: zmkfirmware
    revision: main
    import: app/west.yml
  - name: zmk-config-totem
    url: https://github.com/GEIGEIGEIST/zmk-config-totem.git
    revision: master
    path: modules/zmk-config-totem
  - name: zmk-dongle-display
    url: https://github.com/englmaxi/zmk-dongle-display.git
    revision: main
    path: modules/zmk-dongle-display
  self:
    path: config
```
